## main/Kconfig.projbuild
```kconfig
# put here your custom config value
menu "Application Configuration"
    config MQTT_HOST
        string "MQTT_HOST"
        default "mqtt://myhost"
        help
            MQtt host url
    config MQTT_TOPIC_RECOGNITION
        string "MQTT TOPIC_RECOGNITION"
        default "/topic/face/recognized/01"
        help
            Face recognition topic    
    config MQTT_TOPIC_COMMAND
        string "MQTT_TOPIC_COMMAND"
        default "/topic/face/command/01"
        help
            Camera command topic        
endmenu
```

## sdkconfig.defaults
```kconfig
CONFIG_ESPTOOLPY_FLASHSIZE_4MB=y

CONFIG_ESPTOOLPY_FLASHFREQ_80M=y
CONFIG_ESPTOOLPY_FLASHMODE_QIO=y

CONFIG_SPIRAM_SPEED_80M=y
CONFIG_SPIRAM_USE_CAPS_ALLOC=y

CONFIG_PARTITION_TABLE_CUSTOM=y
CONFIG_PARTITION_TABLE_CUSTOM_FILENAME="partitions.csv"

CONFIG_S16=y
CONFIG_ESP_INT_WDT=n
CONFIG_ESP_TASK_WDT=n

CONFIG_BOOTLOADER_COMPILER_OPTIMIZATION_SIZE=y
CONFIG_BOOTLOADER_COMPILER_OPTIMIZATION_DEBUG=n
CONFIG_BOOTLOADER_COMPILER_OPTIMIZATION_PERF=n
CONFIG_BOOTLOADER_COMPILER_OPTIMIZATION_NONE=n

CONFIG_OV7670_SUPPORT=n
CONFIG_OV7725_SUPPORT=n
CONFIG_NT99141_SUPPORT=n
CONFIG_OV3660_SUPPORT=n
CONFIG_OV5640_SUPPORT=n
CONFIG_GC2145_SUPPORT=n
CONFIG_GC032A_SUPPORT=n
CONFIG_GC0308_SUPPORT=n
CONFIG_BF3005_SUPPORT=n
CONFIG_BF20A6_SUPPORT=n
CONFIG_SCCB_HARDWARE_I2C_PORT0=n

CONFIG_CAMERA_MODULE_AI_THINKER=y
```
